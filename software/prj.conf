## CMakeLists.txt
```
cmake_minimum_required(VERSION 3.20.0)

# These must come BEFORE the zephyr package declaration.
set(DTC_OVERLAY_FILE "../firmware/overlay.dts")
set(BOARD "litex_vexriscv")
set(EXTRA_CFLAGS "-Wfatal-errors -Werror -Wno-error=unused-const-variable -Wno-error=unused-variable -Wno-error=unused-function")
include("../firmware/overlay.cmake")

find_package(Zephyr)
project(upsilon)
include_directories("../firmware")
include_directories("src/")
include_directories("../creole")
include_directories("../firmware/rtl/control_loop")

set_source_files_properties(src/main.c PROPERTIES COMPILE_FLAGS -DMAIN_LOG_LEVEL=4)
set_source_files_properties(../creole/creole.c PROPERTIES COMPILE_FLAGS -DCREOLE_LOG_LEVEL=4)

# Add all source files here.
target_sources(app PRIVATE src/access.c src/buf.c src/main.c src/sock.c ../creole/creole.c)
# target_sources(app PRIVATE src/tests/test_ethernet.c)
```

## Kconfig
```
mainmenu "CryoSNOM 1"

source "Kconfig.zephyr"
```

## prj.conf
```kconfig
CONFIG_LOG=y
CONFIG_NET_LOG=y
CONFIG_LOG_BUFFER_SIZE=1024
CONFIG_LOG_PRINTK=y
CONFIG_LOG_DEFAULT_LEVEL=3

CONFIG_NETWORKING=y
CONFIG_NET_IPV4=y
CONFIG_NET_IPV6=n
CONFIG_NET_TCP=y
CONFIG_NET_SOCKETS=y
CONFIG_NET_ARP=y
CONFIG_NET_UDP=y

CONFIG_NET_TCP_ISN_RFC6528=n

CONFIG_INIT_STACKS=y
CONFIG_THREAD_LOCAL_STORAGE=y
CONFIG_SCHED_SCALABLE=y

CONFIG_NET_CONFIG_SETTINGS=y
CONFIG_NET_CONFIG_NEED_IPV4=y
CONFIG_NET_MGMT=y
CONFIG_NET_MGMT_EVENT=y
# Ethernet config. Change me for your setup!
CONFIG_NET_DHCPV4=n
CONFIG_NET_CONFIG_MY_IPV4_ADDR="192.168.1.50"
CONFIG_NET_CONFIG_MY_IPV4_GW="192.168.1.1"
CONFIG_NET_CONFIG_MY_IPV4_NETMASK="255.255.255.0"
```

## src/main.c
```c
#include <zephyr/zephyr.h>
#include <errno.h>
#include <zephyr/net/socket.h>
#include <zephyr/kernel.h>
#include <zephyr/logging/log.h>

#include "upsilon.h"
#include "access.h"
#include "sock.h"
#include "buf.h"

LOG_MODULE_REGISTER(main, 4);

#define THREAD_STACK_SIZ 1024*32
#define THREADNUM 32
static K_KERNEL_STACK_ARRAY_DEFINE(stacks, THREADNUM, THREAD_STACK_SIZ);

#define READBUF_SIZ 0xFFFF
static unsigned char readbuf[THREADNUM][READBUF_SIZ];
static struct k_thread threads[THREADNUM];
static bool thread_ever_used[THREADNUM];

static const char *const compiler_ret_str[CREOLE_COMPILE_RET_LEN] = {
	[CREOLE_COMPILE_OK] = "compile ok",
	[CREOLE_OPCODE_READ_ERROR] = "opcode read error",
	[CREOLE_OPCODE_MALFORMED] = "opcode malformed",
	[CREOLE_ARG_READ_ERROR] = "arg read error",
	[CREOLE_ARG_MALFORMED] = "arg malformed",
	[CREOLE_LAST_READ_ERROR] = "last read error",
	[CREOLE_LAST_MALFORMED] = "last malformed",
	[CREOLE_DATA_OVERFLOW] = "data overflow",
	[CREOLE_TYPE_ERROR] = "type error",
	[CREOLE_PROGRAM_OVERFLOW] = "program overflow"
};

static const char *const run_ret_str[CREOLE_RUN_RET_LEN] = {
	[CREOLE_STEP_CONTINUE] = "continue",
	[CREOLE_STEP_SYSCALL] = "syscall",
	[CREOLE_STEP_STOP] = "stop",
	[CREOLE_STACK_OVERFLOW] = "overflow",
	[CREOLE_STACK_UNDERFLOW] = "underflow",
	[CREOLE_RUN_DECODE_ERROR] = "decode error",
	[CREOLE_REGISTER_OVERFLOW] = "register overflow",
	[CREOLE_STEP_UNKNOWN_OPCODE] = "unknown opcode",
	[CREOLE_DIV_BY_ZERO] = "div by zero",
	[CREOLE_STEP_HIGH_BIT_MALFORMED] = "high bit malformed",
	[CREOLE_JUMP_OVERFLOW] = "jump overflow"
};

/* Returns 0 if the sock is still connected. */
static int
hup(int sock)
{
	struct zsock_pollfd fd = {
		.fd = sock,
		.events = POLLHUP,
		.revents = 0
	};

	return zsock_poll(&fd, 1, 0);
}

static void
exec_creole(unsigned char *buf, int size, int sock)
{
#define DATSLEN 64
	struct creole_reader dats[DATSLEN];
#define REGLEN 32
	creole_word reg[REGLEN];
#define STKLEN 1024
	creole_word stk[STKLEN];

	struct creole_env env = {
		.dats = dats,
		.datlen = DATSLEN,
		.reg = reg,
		.reglen = REGLEN,
		.stk = stk,
		.stklen = STKLEN,

		.r_current = {buf, size},
		.r_start = {buf, size},
		.fd = sock
	};

	int e = creole_compile(&env);
	if (e != CREOLE_COMPILE_OK) {
		LOG_WRN("%s: compile: %s at %zu", get_thread_name(),
		        compiler_ret_str[e],
		        (env.r_start.left - env.r_current.left));
		return;
	}

	for (;;) {
		creole_word sc;
		e = creole_step(&env, &sc);
		LOG_DBG("%s: %s", get_thread_name(), run_ret_str[e]);
		switch (e) {
		case CREOLE_STEP_CONTINUE:
			continue;
		case CREOLE_STEP_SYSCALL:
			LOG_WRN("%s: syscall unsupported", get_thread_name());
			continue;
		case CREOLE_STEP_STOP:
			return;
		default:
			LOG_WRN("%s: run: %s", get_thread_name(),
			        run_ret_str[e]);
			return;
		}

		if (hup(sock) != 0) {
			LOG_WRN("%s: hangup", get_thread_name());
			return;
		}
	}
}

/* Read the size of the message from the socket. */
static int
read_size(int s)
{
	char buf[2];
	struct bufptr bp = {buf, sizeof(buf)};
	int e = sock_read_buf(s, &bp, true);
	if (e != 0)
		return e;
	return (unsigned char)buf[0] | (unsigned char) buf[1] << 8;
}

/* Thread entry. Reads the program send by the connection and executes it. */
static void
exec_entry(void *client_p, void *connection_num_p,
           void *threadnum_p)
{
	intptr_t client = (intptr_t)client_p;
	intptr_t connection_num = (intptr_t)connection_num_p;
	intptr_t threadnum = (intptr_t)threadnum_p;
	char thread_name[64];
	snprintk(thread_name, sizeof(thread_name), "%"PRIdPTR":%"PRIdPTR, threadnum, connection_num);
	k_thread_name_set(k_current_get(), thread_name);

	LOG_DBG("%s: entered thread", get_thread_name());

	int size = read_size(client);
	if (size < 0) {
		LOG_WRN("%s: error in read size: %d", get_thread_name(), size);
		zsock_close(client);
		return;
	}
	LOG_INF("%s: program length: %d", get_thread_name(), size);

	struct bufptr bp = {readbuf[threadnum], size};
	int e = sock_read_buf(client, &bp, true);
	if (e != 0) {
		LOG_WRN("%s: error in read body: %d", get_thread_name(), e);
		zsock_close(client);
		return;
	}
	LOG_DBG("%s: read program", get_thread_name());

	exec_creole(readbuf[threadnum], size, (int)client);
	zsock_close(client);
	LOG_INF("Exiting thread %s", get_thread_name());
}

static void
main_loop(int srvsock)
{
	static unsigned int connection_counter = 0;
	for (;;) {
		int client = server_accept_client(srvsock);
		int i;

		for (i = 0; i < THREADNUM; i++) {
			if (!thread_ever_used[i] || k_thread_join(&threads[i], K_NO_WAIT) == 0) {
				LOG_DBG("launching thread %d", i);
				connection_counter++;
				thread_ever_used[i] = true;
				k_thread_create(&threads[i], stacks[i],
				THREAD_STACK_SIZ, exec_entry,
				(void*) client, (void*) connection_counter,
				NULL, 1, 0, K_NO_WAIT);
				break;
			}
		}

		if (i == THREADNUM) {
			LOG_INF("Too many connections (max %d)",
			        THREADNUM);
			zsock_close(client);
		}
	}
}

/* For reproducible builds if needed */
#ifdef SOURCE_DATE_EPOCH
# define BUILD_TIME SOURCE_DATE_EPOCH
#else
# define BUILD_TIME __DATE__ " " __TIME__
#endif
void
main(void)
{
	LOG_PRINTK("Upsilon on ZephyrOS, built on %s\n", BUILD_TIME);
	access_init();
	k_thread_name_set(k_current_get(), "main thread");
	for (;;) {
		int sock = server_init_sock(6626);
		main_loop(sock);
		zsock_close(sock);
	}
}
```

## src/access.c
```c
/* Verilog access control.
 *
 * Mutex management for hardware resources.
 * Each mutex has a thread-local lock counter associated with it, since in
 * Zephyr the recursive lock counter is not publically accessable.
 *
 * On the final unlock for a thread, the code will always take steps to
 * reset the state of the Verilog module so that another thread will
 * see a consistent start state.
 */

#include <zephyr/kernel.h>
#include <soc.h>
#include <zephyr/logging/log.h>
#include "upsilon.h"
#include "access.h"
#include "control_loop_cmds.h"

LOG_MODULE_REGISTER(access, 4);
#include "pin_io.c"

/* The values from converters are not aligned to 32 bits.
 * These values are still in twos compliment and have to be
 * manually sign-extended.
 */
static inline uint32_t
sign_extend(uint32_t in, unsigned len)
{
	if (in >> (len - 1) & 1) {
		uint32_t mask = (1 << len) - 1;
		return ~mask | (in & mask);
	} else {
		return in;
	}
}

/*********************
 * DAC
 *********************/

static struct k_mutex dac_mutex[DAC_MAX];
static __thread int dac_locked[DAC_MAX];

int
dac_take(int dac, k_timeout_t timeout)
{
	if (dac < 0 || dac >= DAC_MAX)
		return -EFAULT;

	int e = k_mutex_lock(dac_mutex + dac, timeout);
	if (e == 0) {
		dac_locked[dac] += 1;
	}
	return e;
}

int
dac_release(int dac)
{
	if (dac < 0 || dac >= DAC_MAX)
		return -EFAULT;

	if (dac_locked[dac] == 1) {
		write_dac_arm(0, dac);
		// TODO: Flush DAC?
		// while (!read_dac_finished(dac));
	}

	int e = k_mutex_unlock(dac_mutex + dac);
	if (e == 0) {
		dac_locked[dac] -= 1;
	}
	return e;
}

int
dac_read_write(int dac, creole_word send, k_timeout_t timeout, 
               creole_word *recv)
{
	int e = dac_take(dac, timeout);
	if (e != 0)
		return e;
	dac_switch(dac, DAC_SPI_PORT, K_NO_WAIT);

	write_to_dac(send, dac);
	write_dac_arm(1, dac);

	/* Non-recursive locks should busy wait. */
	/* 10ns * (2 * 10 cycles per half DAC cycle)
	        * 24 bits
	 */
	if (dac_locked[dac] > 1)
		k_sleep(K_NSEC(10*2*10*24));
	while (!read_dac_finished(dac));

	if (recv)
		*recv = sign_extend(read_from_dac(dac), 20);
	write_dac_arm(0, dac);

	dac_release(dac);
	return 0;
}

int
dac_switch(int dac, int setting, k_timeout_t timeout)
{
	int e = dac_take(dac, timeout);
	if (e != 0)
		return e;

	write_dac_sel(setting, dac);

	dac_release(dac);
	return 0;
}

/**********************
 * adc read
 *********************/

static struct k_mutex adc_mutex[ADC_MAX];
static __thread int adc_locked[ADC_MAX];

int
adc_take(int adc, k_timeout_t timeout)
{
	if (adc < 0 || adc >= ADC_MAX)
		return -EFAULT;

	LOG_DBG("%s: taking adc %d", get_thread_name(), adc);
	int e = k_mutex_lock(adc_mutex + adc, timeout);
	LOG_DBG("%s: adc %d taken", get_thread_name(), adc);
	if (e == 0) {
		adc_locked[adc] += 1;
	}
	LOG_DBG("%s: adc %d lockeg", get_thread_name(), adc);
	return e;
}

int
adc_release(int adc)
{
	if (adc < 0 || adc >= ADC_MAX)
		return -EFAULT;

	LOG_DBG("%s: in adc_release", get_thread_name());
	if (adc_locked[adc] == 1) {
		write_adc_arm(0, adc);
		// TODO: flush ADC?
	}

	int e = k_mutex_unlock(adc_mutex + adc);
	if (e == 0) {
		adc_locked[adc] -= 1;
	}
	return e;
}

int
adc_switch(int adc, int setting, k_timeout_t timeout)
{
	/* As of now, only one ADC (the CLOOP adc) is used
	 * by two modules at the same time.
	 */
	if (adc != 0)
		return -ENOENT;

	int e = adc_take(adc, timeout);
	if (e != 0)
		return e;

	write_adc_sel_0(setting);

	adc_release(adc);
	return 0;
}

int
adc_read(int adc, k_timeout_t timeout, creole_word *wrd)
{
	int e;
	if ((e = adc_take(adc, timeout)) != 0)
		return e;

	adc_switch(adc, ADC_SPI_PORT, K_NO_WAIT);
	write_adc_arm(1, adc);

	/* Recursive locks should busy wait. */
	if (adc_locked[adc] > 1)
		k_sleep(K_NSEC(550 + 24*2*10*10));
	while (!read_adc_finished(adc));

	*wrd = sign_extend(read_from_adc(adc), 20);
	write_adc_arm(0, adc);

	adc_release(adc);
	return 0;
}

/********
 * Control loop
 *******/

static struct k_mutex cloop_mutex;
static __thread int cloop_locked;

int
cloop_take(k_timeout_t timeout)
{
	int e = k_mutex_lock(&cloop_mutex, timeout);
	if (e == 0) {
		cloop_locked++;
	}
	return e;
}

int
cloop_release(void)
{
	/* Do not attempt to reset the CLOOP interface.
	 * Other scripts will fight to modify the CLOOP constants
	 * while the loop is still running.
	 */
	int e = k_mutex_unlock(&cloop_mutex);
	if (e == 0) {
		cloop_locked--;
	}
	return e;
}

int
cloop_read(int code, uint32_t *high_reg, uint32_t *low_reg,
           k_timeout_t timeout)
{
	uint64_t v = 0;
	if (cloop_take(timeout) != 0)
		return 0;

	write_cl_cmd(code);
	write_cl_start_cmd(1);
	while (!read_cl_finish_cmd());
	v = read_cl_word_out();
	write_cl_start_cmd(0);

	*high_reg = v >> 32;
	*low_reg = v & 0xFFFFFFFF;

	cloop_release();
	return 1;
}

int
cloop_write(int code, uint32_t high_val, uint32_t low_val,
            k_timeout_t timeout)
{
	if (cloop_take(timeout) != 0)
		return 0;

	write_cl_cmd(code);
	write_cl_word_in((uint64_t) high_val << 32 | low_val);
	write_cl_start_cmd(1);
	while (!read_cl_finish_cmd());
	write_cl_start_cmd(0);

	cloop_release();
	return 1;
}

/************
 * Waveforms
 ***********/

static struct k_mutex waveform_mutex[DAC_MAX];
static __thread int waveform_locked[DAC_MAX];

int
waveform_take(int waveform, k_timeout_t timeout)
{
	if (waveform < 0 || waveform >= DAC_MAX)
		return -EFAULT;

	int e = k_mutex_lock(waveform_mutex + waveform, timeout);
	if (e == 0) {
		waveform_locked[e]++;
	}
	return e;
}

static void
waveform_disarm_wait(int wf)
{
	write_wf_arm(0, wf);
	/* TODO: add wait */
	while (read_wf_running(wf));
}

int
waveform_release(int waveform)
{
	if (waveform < 0 || waveform >= DAC_MAX)
		return -EFAULT;

	if (waveform_locked[waveform] == 1) {
		waveform_disarm_wait(waveform);
	}

	int e = k_mutex_unlock(waveform_mutex + waveform);
	if (e == 0) {
		waveform_locked[e]--;
	}
	return e;
}

size_t
creole_to_array(const struct creole_reader *start, creole_word *buf, size_t buflen)
{
	size_t i = 0;
	struct creole_word w;
	struct creole_reader r = *start;

	while (creole_decode(&r, &w) && i < buflen) {
		buf[i++] = w.word;
	}

	return i;
}

int
waveform_load(uint32_t buf[MAX_WL_SIZE], int slot, k_timeout_t timeout)
{
	if (waveform_take(slot, timeout) != 0)
		return 0;

	write_wf_start_addr((uint32_t) buf, slot);
	write_wf_refresh_start(1, slot);
	while (!read_wf_refresh_finished(slot));
	write_wf_refresh_start(0, slot);

	waveform_release(slot);
	return 1;
}

int
waveform_halt_until_finished(int slot)
{
	write_wf_halt_on_finish(1, slot);
	while (!read_wf_finished(slot));
	return 1;
}

int
waveform_arm(int slot, bool halt_on_finish, uint32_t wait, k_timeout_t timeout)
{
	if (waveform_take(slot, timeout) != 0)
		return 0;
	if (dac_take(slot, timeout) != 0) {
		waveform_release(slot);
		return 0;
	}

	dac_switch(slot, DAC_WF_PORT, K_NO_WAIT);

	write_wf_halt_on_finish(halt_on_finish, slot);
	write_wf_time_to_wait(wait, slot);
	write_wf_arm(1, slot);

	return 1;
}

int
waveform_disarm(int slot)
{
	waveform_disarm_wait(slot);
	waveform_release(slot);
	dac_release(slot);
	return 1;
}

/**********
 * Init and deinit
 *********/

void
access_release_thread(void)
{
	while (cloop_release() == 0)
		cloop_locked--;
	if (cloop_locked != 0) {
		LOG_WRN("%s: cloop mutex counter mismatch", get_thread_name());
		cloop_locked = 0;
	}

	for (int i = 0; i < DAC_MAX; i++) {
		while (dac_release(i) == 0)
			dac_locked[i]--;
		if (dac_locked[i] != 0) {
			LOG_WRN("%s: dac mutex %d counter mismatch", get_thread_name(), i);
			dac_locked[i] = 0;
		}

		while (waveform_release(i) == 0)
			waveform_locked[i]--;
		if (waveform_locked[i] != 0) {
			LOG_WRN("%s: waveform mutex %d counter mismatch", get_thread_name(), i);
			waveform_locked[i] = 0;
		}
	}

	for (int i = 0; i < ADC_MAX; i++) {
		while (adc_release(i) == 0)
			adc_locked[i]--;
		if (adc_locked[i] != 0) {
			LOG_WRN("%s: adc mutex %d counter mismatch", get_thread_name(), i);
			adc_locked[i] = 0;
		}
	}
}

void
access_init(void)
{
	LOG_INF("access_init");
	if (k_mutex_init(&cloop_mutex) != 0) {
		LOG_ERR("err: cloop mutex");
		k_fatal_halt(K_ERR_KERNEL_PANIC);
	}

	for (int i = 0; i < DAC_MAX; i++) {
		if (k_mutex_init(dac_mutex + i) != 0) {
			LOG_ERR("err: dac mutex %d", i);
			k_fatal_halt(K_ERR_KERNEL_PANIC);
		}

		if (k_mutex_init(waveform_mutex + i) != 0) {
			LOG_ERR("err: waveform mutex %d", i);
			k_fatal_halt(K_ERR_KERNEL_PANIC);
		}
	}

	for (int i = 0; i < ADC_MAX; i++) {
		if (k_mutex_init(adc_mutex + i) != 0) {
			LOG_ERR("err: adc mutex %d", i);
			k_fatal_halt(K_ERR_KERNEL_PANIC);
		}
	}
	LOG_INF("access_init done");
}
```

## src/access.h
```c
#pragma once
#include <zephyr/kernel.h>
#include "creole.h"

int dac_take(int dac, k_timeout_t timeout);
int dac_release(int dac);
int dac_read_write(int dac, creole_word send, k_timeout_t timeout,
                   creole_word *recv);

/* These ports are defined in firmware/rtl/base/base.v.m4 */
#define DAC_SPI_PORT 0
#define DAC_WF_PORT 1
#define DAC_CLOOP_PORT 2
int dac_switch(int dac, int setting, k_timeout_t timeout);

int adc_take(int adc, k_timeout_t timeout);
int adc_release(int adc);
int adc_read(int adc, k_timeout_t timeout, creole_word *wrd);

#define ADC_SPI_PORT 0
#define ADC_CLOOP_PORT 1
int adc_switch(int adc, int setting, k_timeout_t timeout);

int cloop_take(k_timeout_t timeout);
int cloop_read(int code, uint32_t *high_reg, uint32_t *low_reg,
               k_timeout_t timeout);
int cloop_write(int code, uint32_t high_val, uint32_t low_val,
                k_timeout_t timeout);
int cloop_release(void);

int waveform_take(int waveform, k_timeout_t timeout);
int waveform_release(int waveform);

#define MAX_WL_SIZE 4096
int waveform_load(uint32_t buf[MAX_WL_SIZE], int slot, k_timeout_t timeout);
int waveform_arm(int slot, bool halt_on_finish, uint32_t wait, k_timeout_t timeout);
int waveform_disarm(int slot);


/* Zephyr OS does not automatically clean up mutex resources.
 * This will release all held locks.
 */
void access_release_thread(void);

/* Called once on initializion. */
void access_init(void);
```

## src/buf.c
```c
#include <zephyr/zephyr.h>
#include <zephyr/sys/printk.h>
#include "buf.h"

int
buf_writevf(struct bufptr *bp, const char *fmt, va_list va)
{
	/* vsnprintk() returns the amount of bytes that would
	 * be stored in the buffer if the buffer was big enough,
	 * excluding the NUL terminator.
	 * The function will _always_ write a NUL terminator
	 * unless bp->left == 0.
	 */
	int w = vsnprintk(bp->p, bp->left, fmt, va);

	if (w < 0)
		return BUF_WRITE_ERR;

	/* Return the number of bytes that are required to be
	 * written.
	 * Do not increment the buffer pointer, the truncated
	 * data may not be safe.
	 * Since w is the amount of required bytes minus the NUL
	 * terminator, w == bp->left is still an out-of-memory
	 * situation.
	 */
	if (w >= bp->left) {
		return w - bp->left + 1;
	} else {
		bp->p += w;
		bp->left -= w;
		return BUF_OK;
	}
}

int
buf_writef(struct bufptr *bp, const char *fmt, ...)
{
	va_list va;
	va_start(va, fmt);
	int r = buf_writevf(bp, fmt, va);
	va_end(va);
	return r;
}
```

## src/buf.h
```c
#pragma once

/* This is a pointer _into_ a buffer. It is incremented (and the variable
 * "left" decremented) after each operation.
 *
 * Space is always left for a NUL terminator.
 */
struct bufptr {
	char *p;
	size_t left;
};

enum {
	BUF_OK = 0,
	BUF_WRITE_ERR = -1,
	BUF_SOCK_ERR = -2
};

/* Write a formatted string to bp.
 * This function uses printf(), which means that it deals with
 * writing _C-strings_, not unterminated buffers.
 * When using this function, the buffer must be _one more_ than
 * the maximum message length. For instance, a 1024-byte message
 * should be in a 1025-byte buffer. HOWEVER, bp->left must still
 * be set to the total length of the buffer (in the example, 1025).
 *
 * The final bufptr points to the NUL terminator, so that it
 * is overwritten on each call to the function.
 *
 * This function returns 0 for a successful write, -1 for an
 * encoding error (should never happen), and a positive value
 * for the amount of bytes that could not fit.
 */
int buf_writevf(struct bufptr *bp, const char *fmt, va_list va);
int buf_writef(struct bufptr *bp, const char *fmt, ...);
```

## src/creole_interface.c
```c
#include <zephyr/sys_clock.h>
#include <zephyr/kernel.h>
#include <zephyr/sys/util.h>
#include "control_loop_cmds.h"
#include "creole.h"
#include "creole_upsilon.h"
#include "pin_io.h"
#include "creole.h"

creole_word
upsilon_get_adc(creole_word adc, creole_word *ret)
{
	return adc_read(adc, K_FOREVER, ret);
}

creole_word
upsilon_get_dac(creole_word dac, creole_word *ret)
{
	int e;
	e = dac_read_write(dac, 0x1 << 23 | 0x1 << 20, K_FOREVER, NULL);
	if (e != 0)
		return e;
	return dac_read_write(dac, 0, K_FOREVER, ret);
}

creole_word
upsilon_write_dac(creole_word dac, creole_word val)
{
	return dac_read_write(dac, 0x1 << 20 | val, K_FOREVER, NULL);
}

creole_word
upsilon_usec(creole_word usec)
{
	k_sleep(K_USEC(usec));
	return 0;
}

creole_word
upsilon_control_loop_read(creole_word *high_reg,
                          creole_word *low_reg,
                          creole_word code)
{
	return cloop_read(code, high_reg, low_reg, K_FOREVER);
}

creole_word
upsilon_control_loop_write(creole_word high_val,
                           creole_word low_val,
                           creole_word code)
{
	return cloop_write(code, high_val, low_val, K_FOREVER);
}

static size_t
load_into_array(const struct creole_reader *start, creole_word *buf, size_t buflen)
{
	size_t i = 0;
	struct creole_word w;
	struct creole_reader r = start;

	while (creole_decode(&r, &w) && i < buflen) {
		buf[i++] = w.word;
	}

	return i;
}

#define MAX_WL_SIZE 4096
creole_word
upsilon_load_waveform(struct creole_env *env, creole_word slot,
                      creole_word db)
{
	creole_word buf[MAX_WL_SIZE];
	size_t len = load_into_array(env->dats[db], buf, ARRAY_SIZE(buf));
	if (len < MAX_WL_SIZE)
		return 0;
	return waveform_load(buf, slot, K_FOREVER);
}

creole_word
upsilon_arm_waveform(creole_word slot, creole_word hof, creole_word wait)
{
	return waveform_arm(slot, hof, wait, K_FOREVER);
}

creole_word
upsilon_disarm_waveform(creole_word slot)
{
	return waveform_disarm(slot);
}

creole_word
upsilon_sendval(struct creole_env *env, creole_word num)
{
	char buf[32];
	struct bufptr bp = {buf, sizeof(buf)};

	return sock_printf(env->fd, &bp, "%u", num) == BUF_OK;
}

creole_word
upsilon_senddat(struct creole_env *env, creole_word db)
{
	char buf[128];
	struct bufptr bp = {buf, 0};
	struct creole_word w;
	struct creole_reader r = start;

	while (creole_decode(&r, &w) && bp.left < buflen) {
		if (w.word > 0xFF)
			return 0;
		buf[bp.left++] = w.word;
	}

	return sock_write_buf(env->fd, &bp);
}

creole_word
upsilon_take_adc(creole_word slot, creole_word timeout)
{
	return adc_take(slot, K_USEC(timeout));
}

creole_word
upsilon_release_adc(creole_word slot)
{
	return adc_release(slot);
}

creole_word
upsilon_take_dac(creole_word slot, creole_word timeout)
{
	return dac_take(slot, K_USEC(timeout));
}

creole_word
upsilon_release_dac(creole_word slot)
{
	return dac_release(slot);
}

creole_word
upsilon_take_wf(creole_word slot, creole_word timeout)
{
	return waveform_take(slot, K_USEC(timeout));
}

creole_word
upsilon_release_wf(creole_word slot)
{
	return waveform_release(slot);
}

creole_word
upsilon_take_cloop(creole_word timeout)
{
	return cloop_take(K_USEC(timeout));
}

creole_word
upsilon_release_cloop(void)
{
	return cloop_release();
}
```

## src/io.c
```c
#include <zephyr/zephyr.h>
#include <zephyr/kernel.h>
#include <zephyr/logging/log.h>

LOG_MODULE_REGISTER(adc_dac_io);

#include <string.h>
#define CSR_LOCATIONS
#include "pin_io.h"

static int32_t
sign_extend(uint32_t n, unsigned wid)
{
	if (n >> (wid - 1))
		return (int32_t) (~((uint32_t) 0) & n);
	else
		return (int32_t) n;
}

int32_t
adc_read(size_t num, unsigned wid)
{
	if (num >= ADC_MAX) {
		LOG_ERR("adc_read got bad ADC %zd\n", num);
		k_fatal_halt(K_ERR_KERNEL_OOPS);
	}
	if (wid > 32) {
		LOG_ERR("adc_read got bad width %u\n", wid);
		k_fatal_halt(K_ERR_KERNEL_OOPS);
	}

	*adc_conv[num] = 1;
	k_sleep(K_NSEC(550));
	*adc_arm[num] = 1;
	*adc_conv[num] = 0;
	// XXX: Guess
	k_sleep(K_MSEC(40));
	while (!*adc_finished[num]);

	uint32_t buf = *adc_from_slave[num];
	*adc_arm[num] = 0;
	return sign_extend(buf);
}

uint32_t
dac_write_raw(size_t n, uint32_t data)
{
	if (n >= DAC_MAX) {
		LOG_ERR("dac_write_raw got bad ADC %d\n", n);
		k_fatal_halt(K_ERR_KERNEL_OOPS);
	}

	*dac_to_slave[n] = data;
	*dac_ss[n] = 1;
	k_sleep(K_NSEC(20));
	*dac_arm[n] = 1;
	// XXX: Guess
	k_sleep(K_MSEC(50));
	while (!*dac_finished[num]);

	*dac_ss[n] = 0;
	uint32_t r = *dac_from_slave[n];
	*dac_arm[n] = 0;
	return r;
}

void
dac_write_v(size_t n, uint32_t v)
{
	dac_write_raw(n, (1 << 20) | (v & 0xFFFFF));
}

int
dac_init(size_t n)
{
	/* Write to control register. */
	const uint32_t msg =
		(1 << 1) // RBUF
		| (1 << 4) // Binary Offset
	;
	dac_write_raw(n, (1 << 21) | msg);
	// Read from the control register
	dac_write_raw(n, (1 << 21) | (1 << 23));
	// Send NOP to read the returned data.
	return dac_write_raw(n, 0) == msg;
}
```

## src/io.h
```c
#pragma once

int32_t adc_read(size_t num, unsigned wid);

uint32_t dac_write_raw(size_t n, uint32_t data);
void dac_write_v(size_t n, uint32_t v);
int dac_init(size_t n);
```

## src/jsmn.h
```c
/*
 * Jsmn is JSON parser that does not use the C standard library and
 * does not allocate memory. Jsmn stores the structure of the JSON
 * document in an array that records
 * * the type of the token,
 * * the start position and extent of the token,
 * * and the number of elements inside the token.
 * For example, the document
   {"key":"val", "obj" : { "x" : 2, "y" : false }, "arr" : [1, "2", 3]}
 * would contain parse to:
 *   OBJECT 6, STRING "key", STRING "val", STRING "obj", OBJECT 4,
 *   STRING "key", PRIMITIVE 2, STRING y, PRIMITIVE false,
 *   STRING "arr", ARRAY 3, PRIMITIVE 1, STRING "2", PRIMITIVE 3
 * The number next to OBJECT and ARRAY denote the size of each.
 * Strings always start with a quote and end with one: primitives
 * (numbers, booleans, null) do not.
 *
 * TOKENS ARE NOT NUL TERMINATED. However, because of how the JSON
 * grammar works, the NUL terminator can be manually added.
 * STRING ESCAPE SEQUENCES ARE NOT PARSED.
 * Strings start at one-past the quotation mark, and the end index
 * points to the end quotation mark.
 *
 * Why JSON?
 * 1) Every language has a JSON library.
 * 2) JSMN is perfectly suited to this program.
 * 3) Another standard format would most likely require writing
 *    a parser by hand.
 * 4) A minimalistic, custom format would require more debugging.
 *
 * From: https://github.com/zserge/jsmn 25647e692c7906b96ffd2b05ca54c097948e879c
 *
 * MIT License
 *
 * Copyright (c) 2010 Serge Zaitsev
 *
 * Permission is hereby granted, free of charge, to any person obtaining a copy
 * of this software and associated documentation files (the "Software"), to deal
 * in the Software without restriction, including without limitation the rights
 * to use, copy, modify, merge, publish, distribute, sublicense, and/or sell
 * copies of the Software, and to permit persons to whom the Software is
 * furnished to do so, subject to the following conditions:
 *
 * The above copyright notice and this permission notice shall be included in
 * all copies or substantial portions of the Software.
 *
 * THE SOFTWARE IS PROVIDED "AS IS", WITHOUT WARRANTY OF ANY KIND, EXPRESS OR
 * IMPLIED, INCLUDING BUT NOT LIMITED TO THE WARRANTIES OF MERCHANTABILITY,
 * FITNESS FOR A PARTICULAR PURPOSE AND NONINFRINGEMENT. IN NO EVENT SHALL THE
 * AUTHORS OR COPYRIGHT HOLDERS BE LIABLE FOR ANY CLAIM, DAMAGES OR OTHER
 * LIABILITY, WHETHER IN AN ACTION OF CONTRACT, TORT OR OTHERWISE, ARISING FROM,
 * OUT OF OR IN CONNECTION WITH THE SOFTWARE OR THE USE OR OTHER DEALINGS IN THE
 * SOFTWARE.
 */
#ifndef JSMN_H
#define JSMN_H

#include <stddef.h>

#ifdef __cplusplus
extern "C" {
#endif

#ifdef JSMN_STATIC
#define JSMN_API static
#else
#define JSMN_API extern
#endif

/**
 * JSON type identifier. Basic types are:
 * 	o Object
 * 	o Array
 * 	o String
 * 	o Other primitive: number, boolean (true/false) or null
 */
typedef enum {
  JSMN_UNDEFINED = 0,
  JSMN_OBJECT = 1 << 0,
  JSMN_ARRAY = 1 << 1,
  JSMN_STRING = 1 << 2,
  JSMN_PRIMITIVE = 1 << 3
} jsmntype_t;

enum jsmnerr {
  /* Not enough tokens were provided */
  JSMN_ERROR_NOMEM = -1,
  /* Invalid character inside JSON string */
  JSMN_ERROR_INVAL = -2,
  /* The string is not a full JSON packet, more bytes expected */
  JSMN_ERROR_PART = -3
};

/**
 * JSON token description.
 * type		type (object, array, string etc.)
 * start	start position in JSON data string
 * end		end position in JSON data string
 */
typedef struct jsmntok {
  jsmntype_t type;
  int start;
  int end;
  int size;
#ifdef JSMN_PARENT_LINKS
  int parent;
#endif
} jsmntok_t;

/**
 * JSON parser. Contains an array of token blocks available. Also stores
 * the string being parsed now and current position in that string.
 */
typedef struct jsmn_parser {
  unsigned int pos;     /* offset in the JSON string */
  unsigned int toknext; /* next token to allocate */
  int toksuper;         /* superior token node, e.g. parent object or array */
} jsmn_parser;

/**
 * Create JSON parser over an array of tokens
 */
JSMN_API void jsmn_init(jsmn_parser *parser);

/**
 * Run JSON parser. It parses a JSON data string into and array of tokens, each
 * describing
 * a single JSON object.
 */
JSMN_API int jsmn_parse(jsmn_parser *parser, const char *js, const size_t len,
                        jsmntok_t *tokens, const unsigned int num_tokens);

#ifndef JSMN_HEADER
/**
 * Allocates a fresh unused token from the token pool.
 */
static jsmntok_t *jsmn_alloc_token(jsmn_parser *parser, jsmntok_t *tokens,
                                   const size_t num_tokens) {
  jsmntok_t *tok;
  if (parser->toknext >= num_tokens) {
    return NULL;
  }
  tok = &tokens[parser->toknext++];
  tok->start = tok->end = -1;
  tok->size = 0;
#ifdef JSMN_PARENT_LINKS
  tok->parent = -1;
#endif
  return tok;
}

/**
 * Fills token type and boundaries.
 */
static void jsmn_fill_token(jsmntok_t *token, const jsmntype_t type,
                            const int start, const int end) {
  token->type = type;
  token->start = start;
  token->end = end;
  token->size = 0;
}

/**
 * Fills next available token with JSON primitive.
 */
static int jsmn_parse_primitive(jsmn_parser *parser, const char *js,
                                const size_t len, jsmntok_t *tokens,
                                const size_t num_tokens) {
  jsmntok_t *token;
  int start;

  start = parser->pos;

  for (; parser->pos < len && js[parser->pos] != '\0'; parser->pos++) {
    switch (js[parser->pos]) {
#ifndef JSMN_STRICT
    /* In strict mode primitive must be followed by "," or "}" or "]" */
    case ':':
#endif
    case '\t':
    case '\r':
    case '\n':
    case ' ':
    case ',':
    case ']':
    case '}':
      goto found;
    default:
                   /* to quiet a warning from gcc*/
      break;
    }
    if (js[parser->pos] < 32 || js[parser->pos] >= 127) {
      parser->pos = start;
      return JSMN_ERROR_INVAL;
    }
  }
#ifdef JSMN_STRICT
  /* In strict mode primitive must be followed by a comma/object/array */
  parser->pos = start;
  return JSMN_ERROR_PART;
#endif

found:
  if (tokens == NULL) {
    parser->pos--;
    return 0;
  }
  token = jsmn_alloc_token(parser, tokens, num_tokens);
  if (token == NULL) {
    parser->pos = start;
    return JSMN_ERROR_NOMEM;
  }
  jsmn_fill_token(token, JSMN_PRIMITIVE, start, parser->pos);
#ifdef JSMN_PARENT_LINKS
  token->parent = parser->toksuper;
#endif
  parser->pos--;
  return 0;
}

/**
 * Fills next token with JSON string.
 */
static int jsmn_parse_string(jsmn_parser *parser, const char *js,
                             const size_t len, jsmntok_t *tokens,
                             const size_t num_tokens) {
  jsmntok_t *token;

  int start = parser->pos;
  
  /* Skip starting quote */
  parser->pos++;
  
  for (; parser->pos < len && js[parser->pos] != '\0'; parser->pos++) {
    char c = js[parser->pos];

    /* Quote: end of string */
    if (c == '\"') {
      if (tokens == NULL) {
        return 0;
      }
      token = jsmn_alloc_token(parser, tokens, num_tokens);
      if (token == NULL) {
        parser->pos = start;
        return JSMN_ERROR_NOMEM;
      }
      jsmn_fill_token(token, JSMN_STRING, start + 1, parser->pos);
#ifdef JSMN_PARENT_LINKS
      token->parent = parser->toksuper;
#endif
      return 0;
    }

    /* Backslash: Quoted symbol expected */
    if (c == '\\' && parser->pos + 1 < len) {
      int i;
      parser->pos++;
      switch (js[parser->pos]) {
      /* Allowed escaped symbols */
      case '\"':
      case '/':
      case '\\':
      case 'b':
      case 'f':
      case 'r':
      case 'n':
      case 't':
        break;
      /* Allows escaped symbol \uXXXX */
      case 'u':
        parser->pos++;
        for (i = 0; i < 4 && parser->pos < len && js[parser->pos] != '\0';
             i++) {
          /* If it isn't a hex character we have an error */
          if (!((js[parser->pos] >= 48 && js[parser->pos] <= 57) ||   /* 0-9 */
                (js[parser->pos] >= 65 && js[parser->pos] <= 70) ||   /* A-F */
                (js[parser->pos] >= 97 && js[parser->pos] <= 102))) { /* a-f */
            parser->pos = start;
            return JSMN_ERROR_INVAL;
          }
          parser->pos++;
        }
        parser->pos--;
        break;
      /* Unexpected symbol */
      default:
        parser->pos = start;
        return JSMN_ERROR_INVAL;
      }
    }
  }
  parser->pos = start;
  return JSMN_ERROR_PART;
}

/**
 * Parse JSON string and fill tokens.
 */
JSMN_API int jsmn_parse(jsmn_parser *parser, const char *js, const size_t len,
                        jsmntok_t *tokens, const unsigned int num_tokens) {
  int r;
  int i;
  jsmntok_t *token;
  int count = parser->toknext;

  for (; parser->pos < len && js[parser->pos] != '\0'; parser->pos++) {
    char c;
    jsmntype_t type;

    c = js[parser->pos];
    switch (c) {
    case '{':
    case '[':
      count++;
      if (tokens == NULL) {
        break;
      }
      token = jsmn_alloc_token(parser, tokens, num_tokens);
      if (token == NULL) {
        return JSMN_ERROR_NOMEM;
      }
      if (parser->toksuper != -1) {
        jsmntok_t *t = &tokens[parser->toksuper];
#ifdef JSMN_STRICT
        /* In strict mode an object or array can't become a key */
        if (t->type == JSMN_OBJECT) {
          return JSMN_ERROR_INVAL;
        }
#endif
        t->size++;
#ifdef JSMN_PARENT_LINKS
        token->parent = parser->toksuper;
#endif
      }
      token->type = (c == '{' ? JSMN_OBJECT : JSMN_ARRAY);
      token->start = parser->pos;
      parser->toksuper = parser->toknext - 1;
      break;
    case '}':
    case ']':
      if (tokens == NULL) {
        break;
      }
      type = (c == '}' ? JSMN_OBJECT : JSMN_ARRAY);
#ifdef JSMN_PARENT_LINKS
      if (parser->toknext < 1) {
        return JSMN_ERROR_INVAL;
      }
      token = &tokens[parser->toknext - 1];
      for (;;) {
        if (token->start != -1 && token->end == -1) {
          if (token->type != type) {
            return JSMN_ERROR_INVAL;
          }
          token->end = parser->pos + 1;
          parser->toksuper = token->parent;
          break;
        }
        if (token->parent == -1) {
          if (token->type != type || parser->toksuper == -1) {
            return JSMN_ERROR_INVAL;
          }
          break;
        }
        token = &tokens[token->parent];
      }
#else
      for (i = parser->toknext - 1; i >= 0; i--) {
        token = &tokens[i];
        if (token->start != -1 && token->end == -1) {
          if (token->type != type) {
            return JSMN_ERROR_INVAL;
          }
          parser->toksuper = -1;
          token->end = parser->pos + 1;
          break;
        }
      }
      /* Error if unmatched closing bracket */
      if (i == -1) {
        return JSMN_ERROR_INVAL;
      }
      for (; i >= 0; i--) {
        token = &tokens[i];
        if (token->start != -1 && token->end == -1) {
          parser->toksuper = i;
          break;
        }
      }
#endif
      break;
    case '\"':
      r = jsmn_parse_string(parser, js, len, tokens, num_tokens);
      if (r < 0) {
        return r;
      }
      count++;
      if (parser->toksuper != -1 && tokens != NULL) {
        tokens[parser->toksuper].size++;
      }
      break;
    case '\t':
    case '\r':
    case '\n':
    case ' ':
      break;
    case ':':
      parser->toksuper = parser->toknext - 1;
      break;
    case ',':
      if (tokens != NULL && parser->toksuper != -1 &&
          tokens[parser->toksuper].type != JSMN_ARRAY &&
          tokens[parser->toksuper].type != JSMN_OBJECT) {
#ifdef JSMN_PARENT_LINKS
        parser->toksuper = tokens[parser->toksuper].parent;
#else
        for (i = parser->toknext - 1; i >= 0; i--) {
          if (tokens[i].type == JSMN_ARRAY || tokens[i].type == JSMN_OBJECT) {
            if (tokens[i].start != -1 && tokens[i].end == -1) {
              parser->toksuper = i;
              break;
            }
          }
        }
#endif
      }
      break;
#ifdef JSMN_STRICT
    /* In strict mode primitives are: numbers and booleans */
    case '-':
    case '0':
    case '1':
    case '2':
    case '3':
    case '4':
    case '5':
    case '6':
    case '7':
    case '8':
    case '9':
    case 't':
    case 'f':
    case 'n':
      /* And they must not be keys of the object */
      if (tokens != NULL && parser->toksuper != -1) {
        const jsmntok_t *t = &tokens[parser->toksuper];
        if (t->type == JSMN_OBJECT ||
            (t->type == JSMN_STRING && t->size != 0)) {
          return JSMN_ERROR_INVAL;
        }
      }
#else
    /* In non-strict mode every unquoted value is a primitive */
    default:
#endif
      r = jsmn_parse_primitive(parser, js, len, tokens, num_tokens);
      if (r < 0) {
        return r;
      }
      count++;
      if (parser->toksuper != -1 && tokens != NULL) {
        tokens[parser->toksuper].size++;
      }
      break;

#ifdef JSMN_STRICT
    /* Unexpected char in strict mode */
    default:
      return JSMN_ERROR_INVAL;
#endif
    }
  }

  if (tokens != NULL) {
    for (i = parser->toknext - 1; i >= 0; i--) {
      /* Unmatched opened object or array */
      if (tokens[i].start != -1 && tokens[i].end == -1) {
        return JSMN_ERROR_PART;
      }
    }
  }

  return count;
}

/**
 * Creates a new parser based over a given buffer with an array of tokens
 * available.
 */
JSMN_API void jsmn_init(jsmn_parser *parser) {
  parser->pos = 0;
  parser->toknext = 0;
  parser->toksuper = -1;
}

#endif /* JSMN_HEADER */

#ifdef __cplusplus
}
#endif

#endif /* JSMN_H */
```

## src/lsc.h
```c
#ifndef LSC
#define LSC
#include <stddef.h>

#ifndef LSC_MAXARG
# define LSC_MAXARG 32
#endif

#ifndef LSC_MAXBUF
# define LSC_MAXBUF 1024
#endif

struct lsc_line {
	size_t name;
	char *buf[LSC_MAXARG];
	size_t len;
};

struct lsc_parser {
	int state;

	char intbuf[LSC_MAXBUF];
	size_t len;

	char *rptr;
};

enum lsc_r {
	LSC_MORE,
	LSC_OVERFLOW,
	LSC_ARG_OVERFLOW,
	LSC_INVALID_ARGUMENT,
	LSC_COMPLETE
};

void lsc_reset(struct lsc_parser *, char *);
enum lsc_r lsc_read(struct lsc_parser *,
                    struct lsc_line *);
static void lsc_load_ptr(struct lsc_parser *in, char *p) {
	in->rptr = p;
}

#endif
#ifdef LSC_IMPLEMENTATION

enum { LSC_READ, LSC_DISCARD };

static void reset_parse_state(struct lsc_parser *in) {
	in->state = LSC_READ;
	in->len = 0;
}

void lsc_reset(struct lsc_parser *in, char *p) {
	reset_parse_state(in);
	in->rptr = p;
}

static enum lsc_r lsc_parse(struct lsc_parser *in,
                            struct lsc_line *line) {
	char *s = in->intbuf;
	enum lsc_r r = LSC_ARG_OVERFLOW;

	line->name = (*s == ':');
	line->len = 0;

	while (line->len < LSC_MAXARG) {
		line->buf[line->len++] = s;
		for (; *s && *s != '\t'; s++);

		if (!*s) {
			r = LSC_COMPLETE;
			break;
		} else {
			*s = 0;
			s++;
		}
	}

	reset_parse_state(in);
	return r;
}

enum lsc_r lsc_read(struct lsc_parser *psr,
                    struct lsc_line *line) {
	char c;

	if (!psr || !psr->rptr || !line)
		return LSC_INVALID_ARGUMENT;

	while ((c = *psr->rptr)) {
		psr->rptr++;
		if (psr->state == LSC_DISCARD) {
			if (c == '\n') {
				reset_parse_state(psr);
				return LSC_OVERFLOW;
			}
		} else {
			switch (c) {
			case '\n':
				psr->intbuf[psr->len] = 0;
				return lsc_parse(psr, line);
			default:
				if (psr->len == LSC_MAXBUF)
					psr->state = LSC_DISCARD;
				psr->intbuf[psr->len++] = c;
			}
		}
	}

	return LSC_MORE;
}
#endif
```

## src/msg.c
```c
#include <zephyr.h>
#include <zephyr/net/socket.h>
#include <zephyr/kernel.h>
#include <zephyr/logging/log.h>
#include <stdarg.h>

#define JSMN_PARENT_LINKS
#define JSMN_STRICT
#define JSMN_STATIC
#include "jsmn.h"
#include "sock.h"
#include "buf.h"

LOG_MODULE_REGISTER(msg);

enum cmdtype {
	NONE,
	IDENT,
	CONSTS,
	RAMP,
	READ_ADC,
	RESET_DAC,
	RESET,
	CMDTYPE_LEN
};

struct cmd {
	enum cmdtype typ;
	char *version;
	char *msgid;
	char *emsg;
	union {
		char *ident;
		struct {
			int P;
			int I;
			int Vnm;
		} consts;
		struct {
			int dac;
			int offset;
			int dely;
		} rampcmd;
		int read_adc;
		int reset_dac;
		struct {
			int id;
			int blklen;
			int siz;
		} startscan;
	};
};

struct parser {
	struct readbuf *js; // JSON buffer.
	jsmntok_t *ctok; // Parser is at this token.
	jsmntok_t *last; // Last token in the sequence.
	int cli; // Socket.
	struct cmd cmd; // Command parsed into.
};

enum {
	OK = 0,
	CONVERR = BUF_WRITE_ERR,
	SOCKERR = BUF_WRITE_ERR - 1
};

// Serialize struct cmd into JSON and send it.
static int
dispatch(int sock, struct cmd *cmd)
{
	// Add byte for NUL terminator for snprintf()
	char buf[CLIREADBUF_SIZ + sizeof(uint16_t) + 1] = {0};
	struct bufptr bp = {buf, sizeof(buf)};
	int r;

	/* If no version could be read (i.e. sending a message
	 * saying that the JSON was invalid) then send a
	 * version 0 message.
	 */
	if (!cmd->version)
		cmd->version = "0";

	if ((r = buf_writef(&bp, "{\"version\":\"%s\"", cmd->version)) != BUF_OK)
		return r;

	if (cmd->msgid) {
		if ((r = buf_writef(&bp, ",\"msgid\":\"%s\"", cmd->msgid)) != BUF_OK)
			return r;
	}
	if (cmd->emsg) {
		if ((r = buf_writef(&bp, ",\"error\":\"%s\", cmd->emsg)) != BUF_OK)
			return r;
		goto send;
	}

	if (!cmd->emsg) switch (cmd->typ) {
	case IDENT:
		if ((r = buf_writef(&bp, ",\"%s\":\"%s\", sl[IDENT].s, "cryosnom") != 0)
			return r;
		goto send;
	case CONSTS:
		// STUB
		goto send;
	case RAMPCMD:
		// STUB
		goto send;
	case READ_ADC:
		// STUB
		goto send;
	case READ_DAC:
		// STUB
		goto send;
	case STARTSCAN:
		// STUB
		goto send;
	}

send:
	if ((r = buf_writef(&bp, "}")) != 0)
		return r;

	struct bufptr wptr = {buf, sizeof(buf) - bp.left};
	if (!buf_write_sock(sock, &wptr))
		return SOCKERR;
	return OK;
}

static inline bool
eq(jsmntok_t *tk, char *buf, const char *s, size_t slen)
{
	return (slen == buf->end - buf->start
			&& strncasecmp(s, &jr->js[buf->start], slen) == 0);
}
#define liteq(buf,tok,st) liteq((buf), (tok), (st), sizeof(st) - 1)

static inline void
jsmn_term(char *buf, jsmntok_t *tok)
{
	buf[tok->end] = 0;
}

static jsmntok_t
parse_consts(int sock, jsmntok_t *ct, int len, char *js)
{
	while (len > 0) {
		if (liteq(ct, js, "P")) {
			ct++;
			len--;
			if (
}

static bool
parse(int sock, jsmntok_t *first, jsmntok_t *last, char *js)
{
	if (first->type != JSMN_OBJECT) {
		psr->obj.emsg = "malformed json (not an object)";
		goto fail;
	}

	for (jsmntok_t *ct = first; ct < psr->last; ct++) {
		if (liteq(ct, js, "version")) {
			ct++;
			if (!liteq(ct, js, "0")) {
				psr->obj.emsg = "invalid version";
				goto fail;
			}
			jsmn_term(js, ct);
			psr->version = js + ct->start;
		} else if (liteq(ct, js, "msgid")) {
			ct++;
			jsmn_term(js, ct);
			psr->msgid = js + ct->start;
		} else if (liteq(ct, js, "ident")) {
			ct++;
			psr->typ = IDENT;
		} else if (liteq(ct, js, "consts")) {
			ct++;
			psr->typ = CONSTS;
			if (ct->type == JSMN_OBJECT) {
				if (!(ct = parse_consts(sock, ct+1, ct->size, js)))
					goto fail;
			}
		}
	}

fail:
	return dispatch(&psr->obj);
}

/* Read a JSON message, parse it, execute it, and respond to it.
 */
bool
msg_parse_dispatch(int cli, struct readbuf *buf)
{
	jsmn_parser psr;
	jsmntok_t tokens[JSON_MAX_LEN];

	struct cmd cmd = {
		.typ = NONE
	};

	jsmn_init(&psr);

	if (jsmn_parse(buf->buf, buf->readlen, &tokens, JSON_MAX_LEN) < 0) {
		psr.emsg = "malformed json";
		return dispatch(cli, &cmd);
	}

	return parse(cli, &tokens[0], &tokens[JSON_MAX_LEN-1], buf);
}
```

## src/msg.h
```c
#pragma once

/* Controller only supports JSON_MAX_LEN JSON tokens.
 * A token is
 * * the beginning of an object
 * * A key
 * * any value
 * * the beginning of an array

Due to a particular quirk of JSMN, the numbers
can also be strings. Numbers MUST be integers.
msgid SHOULD be a small number.

 Messages are formatted like
{
	"version" : num, // required, set to 0
	"msgid" : str, // optional
	"error" : str, // only from controller, ignored from computer

	// and zero to one of
	"ident" : null,
	"consts" : { // all are optional
		"P" : num,
		"I" : num,
		"Vnm" : num
	}, // or null
	"ramp" : {
		"dac" : num,
		"off" : num,
		"dly" : num
	},
	"read_adc" : num,
	"reset_dac" : num,
	"reset_all" : null,
	"startscan" : null, // from computer
	"startscan" : { // from controller
		"id" : int,
		"blksiz" : int,
		"blklen" : int
	}
}

Both the controller and the computer read and write these messages.
*/

#define JSON_MAX_LEN 32

enum msg_ret {
	MSG_OK,
	MSG_BAD_JSON,
	MSG_SOCKERR
};

enum msg_ret msg_parse_dispatch(int client, struct readbuf *buf);
```

## src/sock.c
```c
#include <zephyr/zephyr.h>
#include <errno.h>
#include <zephyr/net/socket.h>
#include <zephyr/kernel.h>
#include <zephyr/logging/log.h>
#include "sock.h"
#include "buf.h"

LOG_MODULE_REGISTER(sock);

int
server_init_sock(int port)
{
	int sock;

	sock = zsock_socket(AF_INET, SOCK_STREAM, IPPROTO_TCP);

	if (sock < 0) {
		LOG_ERR("error: socket: %d", sock);
		k_fatal_halt(K_ERR_KERNEL_PANIC);
	}

	struct sockaddr_in addr = {
		.sin_family = AF_INET,
		.sin_addr = {.s_addr = htonl(INADDR_ANY)},
		.sin_port = htons(port)
	};

	if (zsock_bind(sock, (struct sockaddr *)&addr, sizeof(addr)) < 0) {
		LOG_ERR("error: bind: %d", errno);
		k_fatal_halt(K_ERR_KERNEL_PANIC);
	}

	if (zsock_listen(sock, 5) < 0) {
		LOG_ERR("error: listen: %d", errno);
		k_fatal_halt(K_ERR_KERNEL_PANIC);
	}
	LOG_INF("Upsilon waiting on %d", port);

	return sock;
}

int
server_accept_client(int server)
{
	int client;
	struct sockaddr_in addr;
	socklen_t len = sizeof(addr);

	/* Accept clients in a loop. This should block when there are no clients
	 * so other threads can run.
	 */
	do {
		LOG_DBG("Accept");
		/*
		struct zsock_pollfd server_fd = { .fd = server, .events = ZSOCK_POLLIN };
		zsock_poll(&server_fd, 1, -1);
		*/
		client = zsock_accept(server, (struct sockaddr *)&addr, &len);
		if (client < 0)
			LOG_WRN("error in accept: %d", errno);
	} while (client < 0);

	char ipaddr[32];
	zsock_inet_ntop(addr.sin_family, &addr.sin_addr, ipaddr, sizeof(ipaddr));
	LOG_INF("Connection received from %s", ipaddr);
	return client;
}

int
sock_read_buf(int sock, struct bufptr *bp, bool entire)
{
	do {
		ssize_t l = zsock_recv(sock, bp->p, bp->left, 0);
		if (l == 0)
			return -ECONNRESET;
		if (l < 0)
			return -errno;

		bp->left -= l;
		bp->p += l;
	} while (entire && bp->left > 0);

	return 0;
}

int
sock_write_buf(int sock, struct bufptr *bp)
{
	/* Since send may not send all data in the buffer at once,
	 * loop until it sends all data (or fails).
	 */
	while (bp->left) {
		ssize_t l = zsock_send(sock, bp->p, bp->left, 0);
		if (l == 0)
			return -ECONNRESET;
		if (l < 0)
			return -errno;
		bp->p += l;
		bp->left -= l;
	}

	return 0;
}

int
sock_vprintf(int sock, struct bufptr *bp, const char *fmt, va_list va)
{
	struct bufptr store_bp = *bp;
	int r = buf_writevf(bp, fmt, va);
	if (r != BUF_OK)
		return r;

	/* The difference between the initial and final values of
	 * `left` is the amount of bytes written to the buffer.
	 * Set left to this difference so that the only thing sent
	 * is the bytes written by buf_writevf.
	 */
	store_bp.left -= bp->left;
	if (!sock_write_buf(sock, &store_bp)) {
		return BUF_SOCK_ERR;
	} else {
		return BUF_OK;
	}
}

int
sock_printf(int sock, struct bufptr *bp, const char *fmt, ...)
{
	va_list va;
	va_start(va, fmt);
	bool b = sock_vprintf(sock, bp, fmt, va);
	va_end(va);
	return b;
}
```
